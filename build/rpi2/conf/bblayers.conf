## build/rpi2/conf/bblayers.conf
```bitbake
# LAYER_CONF_VERSION is increased each time build/conf/bblayers.conf
# changes incompatibly
LCONF_VERSION = "6"

BBPATH = "${TOPDIR}"
BBFILES ?= ""

BBLAYERS ?= " \
    ${HOME}/jethro-pocky/meta \
    ${HOME}/jethro-pocky/meta-yocto \
    ${HOME}/meta-openembedded/meta-oe \
    ${HOME}/meta-openembedded/meta-networking \
    ${HOME}/meta-openembedded/meta-python \
    ${HOME}/meta-raspberrypi \
    ${HOME}/share/sf_Downloads/yocto/meta-firehawk \
  "

BBLAYERS_NON_REMOVABLE ?= " \
    ${HOME}/poky-jethro/meta \
    ${HOME}/poky-jethro/meta-yocto \
  "
```

## build/rpi2/conf/local.conf
```bitbake
## Configuration for FireHawk Yocto image                 ##
## Yocto Project 2.0.1 Poky distribution [jethro] branch  ##
## This is a sysvinit system                              ##

## Distribution properties and build features ##

DISTRO = "poky"
MACHINE = "raspberrypi2"

DISTRO_FEATURES_append = "systemd"
DISTRO_FEATURES_remove = "bluetooth bluez5 pcmcia irda xattr zeroconf pci 3g nfs nfc smbfs pulseaudio x11 alsa"
MACHINE_FEATURES_remove = "apm alsa phone bluetooth pcmia rtc"
VIRTUAL_RUNTIME_init_manager = "sysvinit"

PREFERRED_PROVIDER_jpeg = "libjpeg-turbo"
PREFERRED_PROVIDER_jpeg-native = "libjpeg-turbo-native"
PREFERRED_PROVIDER_udev = "systemd"
PREFERRED_VERSION_linux-raspberrypi = "4.4.%"
#PREFERRED_VERSION_linux-raspberrypi = "4.5.%"

LICENSE_FLAGS_WHITELIST = "commercial"

## Build directory variables ##

DL_DIR = "${HOME}/yocto_build_cache/rpi2/oe-sources"
SSTATE_DIR = "${HOME}/yocto_build_cache/rpi2/sstate-cache"
TMPDIR = "${HOME}/yocto_build_cache/rpi2/tmp-jethro"

## Image build optimizations ##

PACKAGE_CLASSES = "package_ipk"
USER_CLASSES = "image-mklibs image-prelink"
PATCHRESOLVE = "noop"
BB_NUMBER_THREADS = "4"
PARALLEL_MAKE = "-j 4"

## Raspberry Pi config.txt settings ##

RPI_3_ARM_FREQ = "1200"
RPI_3_CORE_FREQ = "500"
RPI_3_SDRAM_FREQ = "500"
RPI_3_OVER_VOLTAGE = "0"

RPI_2_ARM_FREQ = "1000"
RPI_2_CORE_FREQ = "500"
RPI_2_SDRAM_FREQ = "500"
RPI_2_OVER_VOLTAGE = "2"

MAX_USB_CURRENT = "1"
AVOID_PWM_PLL = "1"
DISABLE_CAMERA_LED = "1"
DISABLE_OVERSCAN = "1"
DISPMANX_OFFLINE = "1"
ENABLE_SPI_BUS = "1"
ENABLE_I2C = "1"
ENABLE_UART ="1"
ENABLE_RPI3_SERIAL_CONSOLE = "1"
VIDEO_CAMERA = "1"
GPU_MEM = "128"

## i686 or x86_64 ##
SDKMACHINE = "x86_64"

## Debug/Dev Features ##
#BUILDHISTORY_COMMIT = "1"
#INHERIT += "buildhistory"
RM_OLD_IMAGE = "1"
#EXTRA_IMAGE_FEATURES = "debug-tweaks"
#KERNEL_IMAGETYPE = "uImage"

CONF_VERSION = "1"
```
